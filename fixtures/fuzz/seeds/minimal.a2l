ASAP2_VERSION 1 71
/begin PROJECT P "seed"
/begin MODULE M ""
/begin MOD_COMMON "" BYTE_ORDER MSB_LAST /end MOD_COMMON
/begin COMPU_METHOD CM "" LINEAR "%6.1" "u" COEFFS_LINEAR 2 0 /end COMPU_METHOD
/begin RECORD_LAYOUT RL FNC_VALUES 1 UWORD ROW_DIR DIRECT /end RECORD_LAYOUT
/begin CHARACTERISTIC c "" VALUE 0x10000000 RL 0 CM 0 100 /end CHARACTERISTIC
/begin MEASUREMENT v "" UBYTE CM 0 0 0 255 ECU_ADDRESS 0x20000000 /end MEASUREMENT
/end MODULE
/end PROJECT
